## main/Kconfig.projbuild
```kconfig
menu "GPS/IMU acquisition"

    config APP_SD_MOUNT_POINT
        string "TF card mount point"
        default "/sdcard"

    config APP_LOG_TO_SD
        bool "Write CSV logs to the TF card"
        default y

    config APP_LOG_SERIAL_MIRROR
        bool "Mirror CSV log lines to the USB serial console"
        default y

    config APP_SERIAL_MIRROR_DECIM
        int "Mirror only every Nth IMU and magnetometer line"
        range 1 100
        default 10
        help
            Full-rate mirroring of the 100 Hz IMU and magnetometer streams can
            stall the logger behind the console. GNSS and event rows are always
            mirrored in full; IMU/mag rows are decimated by this factor.

    config APP_LOG_AUTOSTART
        bool "Start logging automatically at boot"
        default y

    config APP_LOG_FLUSH_MS
        int "Log flush interval (ms)"
        range 100 60000
        default 1000

    config APP_SD_SPI_FREQ_KHZ
        int "TF card SPI clock (kHz)"
        range 400 20000
        default 10000
        help
            The mount is retried at 4 MHz and 400 kHz if this clock fails, so
            a lower default is not required, but 10 MHz is more tolerant of
            jumper wires and modules without pull-ups than 20 MHz.

    config APP_SD_RETRY_MS
        int "Retry mounting the TF card every N ms while unmounted (0 = off)"
        range 0 600000
        default 2000
        help
            Keeps re-attempting the mount, so a card inserted after boot is
            picked up without a reset. Each attempt also performs a short raw
            SPI handshake, which is what you want to trigger a scope on while
            chasing a wiring fault. Background retries are logged at debug
            level so the 2 s default does not flood the console; the SPI
            traffic itself continues either way.

    config APP_STATUS_PERIOD_S
        int "Periodic status line interval (s)"
        range 1 120
        default 5

    menu "Status LED (GPIO8)"

        config APP_LED_HEARTBEAT
            bool "Blink the on-board LED to show the pipeline state"
            default y
            help
                Gives a console-free indication of what the board is doing:
                  solid on  - TF card mounted, CSV files open
                  2 blinks  - the card answered the raw SPI probe but the
                              mount still failed (marginal contact or supply)
                  1 blink   - nothing on MISO at all (no card / no wiring)
                Useful when the fault being chased is intermittent, because the
                board can be left alone and powered from any source instead of
                having a serial terminal (or a scope probe) attached to it.

        choice APP_LED_ACTIVE_LEVEL
            prompt "LED active level"
            default APP_LED_ACTIVE_HIGH
            config APP_LED_ACTIVE_LOW
                bool "Active low (LED tied to 3V3)"
            config APP_LED_ACTIVE_HIGH
                bool "Active high (LED tied to GND)"
        endchoice

    endmenu

    config APP_KEY_DEBOUNCE_MS
        int "Key debounce time (ms)"
        range 5 500
        default 30

    config APP_KEY_LONGPRESS_MS
        int "Key long-press time (ms)"
        range 300 10000
        default 2000
        help
            Holding KEY1 for this long puts the board into deep sleep; either
            KEY1 or KEY2 wakes it again. A short KEY1 press keeps its existing
            meaning (toggle logging), which is why the press event is emitted
            on release instead of on press.

    config APP_I2C_FREQ_HZ
        int "I2C bus clock (Hz)"
        range 100000 1000000
        default 400000
        help
            Applied to both sensors. The BMI160 driver defaults to 1 MHz and the
            QMC5883L driver to 400 kHz; this project overrides both so the shared
            bus runs at one predictable speed. 400 kHz is the QMC5883L maximum.

    menu "BMI160 accelerometer + gyroscope"

        choice APP_BMI160_I2C_ADDR
            prompt "I2C address"
            default APP_BMI160_I2C_ADDR_GND
            config APP_BMI160_I2C_ADDR_GND
                bool "0x68 (SDO tied to GND)"
            config APP_BMI160_I2C_ADDR_VDD
                bool "0x69 (SDO tied to VDDIO)"
        endchoice

        choice APP_BMI160_ACC_RANGE
            prompt "Accelerometer full scale"
            default APP_BMI160_ACC_RANGE_8G
            config APP_BMI160_ACC_RANGE_2G
                bool "+/- 2 g"
            config APP_BMI160_ACC_RANGE_4G
                bool "+/- 4 g"
            config APP_BMI160_ACC_RANGE_8G
                bool "+/- 8 g"
            config APP_BMI160_ACC_RANGE_16G
                bool "+/- 16 g"
        endchoice

        choice APP_BMI160_GYR_RANGE
            prompt "Gyroscope full scale"
            default APP_BMI160_GYR_RANGE_1000DPS
            config APP_BMI160_GYR_RANGE_125DPS
                bool "+/- 125 dps"
            config APP_BMI160_GYR_RANGE_250DPS
                bool "+/- 250 dps"
            config APP_BMI160_GYR_RANGE_500DPS
                bool "+/- 500 dps"
            config APP_BMI160_GYR_RANGE_1000DPS
                bool "+/- 1000 dps"
            config APP_BMI160_GYR_RANGE_2000DPS
                bool "+/- 2000 dps"
        endchoice

        config APP_BMI160_ODR_HZ
            int "Output data rate for accelerometer and gyroscope (Hz)"
            range 25 1600
            default 100

        choice APP_BMI160_ACC_AVG
            prompt "Accelerometer averaging (low power) / filter bandwidth (normal)"
            default APP_BMI160_ACC_AVG_2
            config APP_BMI160_ACC_AVG_1
                bool "1 sample"
            config APP_BMI160_ACC_AVG_2
                bool "2 samples"
            config APP_BMI160_ACC_AVG_4
                bool "4 samples"
            config APP_BMI160_ACC_AVG_8
                bool "8 samples"
            config APP_BMI160_ACC_AVG_16
                bool "16 samples"
            config APP_BMI160_ACC_AVG_32
                bool "32 samples"
            config APP_BMI160_ACC_AVG_64
                bool "64 samples"
            config APP_BMI160_ACC_AVG_128
                bool "128 samples"
        endchoice

        config APP_BMI160_USE_INT1
            bool "Use BMI160 INT1 (GPIO0) data-ready interrupt"
            default y

    endmenu

    menu "QMC5883L magnetometer"

        config APP_MAG_RATE_HZ
            int "Magnetometer polling rate (Hz)"
            range 1 200
            default 100

        choice APP_QMC5883L_ODR
            prompt "Output data rate"
            default APP_QMC5883L_ODR_100
            config APP_QMC5883L_ODR_10
                bool "10 Hz"
            config APP_QMC5883L_ODR_50
                bool "50 Hz"
            config APP_QMC5883L_ODR_100
                bool "100 Hz"
            config APP_QMC5883L_ODR_200
                bool "200 Hz"
        endchoice

        choice APP_QMC5883L_OSR
            prompt "Oversampling ratio"
            default APP_QMC5883L_OSR_256
            config APP_QMC5883L_OSR_64
                bool "64"
            config APP_QMC5883L_OSR_128
                bool "128"
            config APP_QMC5883L_OSR_256
                bool "256"
            config APP_QMC5883L_OSR_512
                bool "512"
        endchoice

        choice APP_QMC5883L_RANGE
            prompt "Field range"
            default APP_QMC5883L_RANGE_2G
            config APP_QMC5883L_RANGE_2G
                bool "+/- 2 G"
            config APP_QMC5883L_RANGE_8G
                bool "+/- 8 G"
        endchoice

    endmenu

    menu "GNSS (NMEA over UART)"

        config APP_GNSS_BAUD
            int "GNSS UART baud rate"
            default 9600

        config APP_GNSS_UART_PORT
            int "GNSS UART peripheral (0 or 1)"
            range 0 1
            default 1

    endmenu

    menu "WiFi access point and web file browser"

        config APP_WIFI_ENABLE
            bool "Start the WiFi access point and web file browser"
            default y
            help
                Brings up a SoftAP and an HTTP server that lets you list,
                download and preview the CSV files on the TF card. Disable it
                for clean data-collection runs, since WiFi adds CPU load and
                timing jitter.

        config APP_WIFI_SSID
            string "Access point SSID"
            default "esp32c3-gnss"

        config APP_WIFI_PASSWORD
            string "Access point password (8..63 chars, empty for an open AP)"
            default "12345678"

        config APP_WIFI_CHANNEL
            int "WiFi channel (1-13)"
            range 1 13
            default 1
            help
                Channel 1 is the lowest 2.4 GHz channel; it is a safe default
                when a scanner has trouble seeing the network.

        config APP_WIFI_TX_POWER_DBM
            int "Maximum WiFi TX power (dBm)"
            range 2 21
            default 20
            help
                Set explicitly because a conservative default shortens the
                usable range of the SuperMini's small ceramic antenna. Lower it
                if the board browns out during WiFi transmits.

        config APP_WIFI_MAX_STA
            int "Maximum simultaneous clients"
            range 1 8
            default 4

        config APP_WIFI_SCAN_AT_BOOT
            bool "Scan for nearby networks at boot (RF self-check)"
            default n
            help
                Runs one scan right after the AP comes up and logs every network
                it can see. A scan switches the radio away from the AP, so it is
                off by default: while the AP bring-up itself is suspect, the
                boot path is kept identical to the IDF SoftAP example, which
                does not scan. Turn it on to check the receiver.

        config APP_WIFI_STA_TEST
            bool "Join an existing network at boot to test the transmitter"
            default n
            help
                Receiving proves only the receiver; association is a two-way
                exchange, so succeeding here proves the transmitter works too.
                Point it at a phone hotspot, which needs no extra hardware.
                The disconnect reason is logged, and it is the interesting part:
                NO_AP_FOUND means nothing heard our probes (transmit side broken)
                while AUTH_FAIL means the far end answered and only the password
                is wrong (transmit side fine).

        config APP_WIFI_STA_SSID
            string "STA test: SSID to join"
            default ""
            depends on APP_WIFI_STA_TEST

        config APP_WIFI_STA_PASSWORD
            string "STA test: password"
            default ""
            depends on APP_WIFI_STA_TEST

        config APP_WEB_PORT
            int "HTTP port"
            range 1 65535
            default 80

        config APP_WEB_PREVIEW_LINES
            int "Lines returned by the in-browser preview"
            range 10 2000
            default 200

    endmenu

endmenu
```
