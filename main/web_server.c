/*
 * web_server.c - TF card file browser and live attitude feed.
 *
 * Endpoints
 *   GET /                         embedded single-page UI
 *   GET /files                    JSON: { mount, logging, files:[{name,size}] }
 *   GET /download?f=NAME          raw file as an attachment
 *   GET /preview?f=NAME&tail=0|1  first / last APP_WEB_PREVIEW_LINES lines
 *   GET /imu                      JSON: one sensor + GNSS snapshot
 *   GET /stream                   text/event-stream, one snapshot every
 *                                 APP_WEB_STREAM_PERIOD_MS
 *
 * Concurrency
 * -----------
 * The logger task and this server both touch the card. Every FATFS call is
 * wrapped in the shared recursive lock from logger_sd.h, but the lock is
 * released around socket writes: a slow client must never stall the 100 Hz
 * acquisition pipeline. Download and preview therefore read one small chunk
 * under the lock and then send it unlocked.
 *
 * RAM
 * ---
 * No handler's allocation scales with the size of the file it serves. The card
 * holds gigabytes; the heap holds a couple of hundred kilobytes. Every transfer
 * is streamed through a fixed small buffer.
 */
#include "web_server.h"

#include <dirent.h>
#include <math.h>
#include <stdio.h>
#include <stdlib.h>
#include <string.h>
#include <sys/stat.h>

#include "app_config.h"
#include "data_types.h"
#include "i2c_diag.h"
#include "logger_sd.h"

#include "freertos/FreeRTOS.h"
#include "freertos/task.h"

#include "esp_http_server.h"
#include "esp_log.h"

static const char *TAG = "web";

/*
 * Embedded by EMBED_FILES in main/CMakeLists.txt. Note that ESP-IDF derives the
 * symbol from the file's *basename* only, so "web/index.html" becomes
 * _binary_index_html_start/_end.
 */
extern const uint8_t index_html_start[] asm("_binary_index_html_start");
extern const uint8_t index_html_end[]   asm("_binary_index_html_end");

#define SD_LOCK_TIMEOUT_MS   1000
#define DOWNLOAD_CHUNK_BYTES 2048
#define PREVIEW_CHUNK_BYTES  1024
#define LIVE_JSON_BYTES      512
#define MAX_NAME_LEN         64

/* ------------------------------------------------------------------ helpers */

/* snprintf() returns the length it *would* have written; keep it in bounds. */
static int clamp_len(int n, size_t bufsz)
{
    if (n < 0) {
        return 0;
    }
    if ((size_t)n >= bufsz) {
        return (int)bufsz - 1;
    }
    return n;
}

/*
 * Reject anything that could escape the mount point, and anything that would
 * need escaping in the JSON reply (all names here are generated by the
 * firmware, so this is belt and braces).
 */
static bool name_is_safe(const char *name)
{
    if (!name || !*name || strlen(name) > MAX_NAME_LEN) {
        return false;
    }
    if (strstr(name, "..") != NULL) {
        return false;
    }
    if (strchr(name, '/') || strchr(name, '\\')) {
        return false;
    }
    if (strchr(name, '"') || strchr(name, '\n') || strchr(name, '\r')) {
        return false;
    }
    return true;
}

/* Resolve a request-supplied name to an existing regular file. */
static bool resolve_file(const char *name, char *path, size_t path_len)
{
    if (!name_is_safe(name)) {
        return false;
    }

    const int n = snprintf(path, path_len, "%s/%s", APP_LOG_MOUNT_POINT, name);
    if (n < 0 || (size_t)n >= path_len) {
        return false;
    }

    struct stat st;
    return stat(path, &st) == 0 && S_ISREG(st.st_mode);
}

static bool get_name_arg(httpd_req_t *req, char *out, size_t out_len)
{
    char query[160];

    if (httpd_req_get_url_query_len(req) <= 0) {
        return false;
    }
    if (httpd_req_get_url_query_str(req, query, sizeof(query)) != ESP_OK) {
        return false;
    }
    return httpd_query_key_value(query, "f", out, out_len) == ESP_OK;
}

/*
 * Offset of the start of the last `lines` lines, found by walking backwards in
 * small blocks. This is what allows a multi-megabyte log to be previewed
 * without ever holding it in RAM; the alternative (read the whole window, then
 * scan it) is what made large previews fail on allocation.
 *
 * Returns -1 when the card stops responding mid-scan.
 */
static long tail_start_offset(FILE *f, long fsize, unsigned lines,
                              char *buf, size_t bufsz)
{
    long pos = fsize;
    unsigned seen = 0;

    while (pos > 0) {
        size_t want = bufsz;
        if ((long)want > pos) {
            want = (size_t)pos;      /* first block may be short */
        }
        pos -= (long)want;

        if (!sd_fs_lock(SD_LOCK_TIMEOUT_MS)) {
            return -1;
        }
        const bool seeked = (fseek(f, pos, SEEK_SET) == 0);
        const size_t got = seeked ? fread(buf, 1, want, f) : 0;
        sd_fs_unlock();

        if (got != want) {
            return -1;
        }
        /* Count newlines from the end of the block towards its start. */
        for (size_t i = got; i > 0; i--) {
            if (buf[i - 1] == '\n' && ++seen > lines) {
                return pos + (long)i;
            }
        }
    }
    return 0;                        /* fewer than `lines` lines in the file */
}

/*
 * Send at most `max_lines` lines starting at `start`, one small chunk at a
 * time. The card lock is taken per read and released before the socket write,
 * exactly like h_download, so a slow client cannot stall the logger.
 */
static esp_err_t stream_lines(httpd_req_t *req, FILE *f, long start,
                              unsigned max_lines, char *buf, size_t bufsz)
{
    if (!sd_fs_lock(SD_LOCK_TIMEOUT_MS)) {
        return ESP_FAIL;
    }
    const bool seeked = (fseek(f, start, SEEK_SET) == 0);
    sd_fs_unlock();
    if (!seeked) {
        return ESP_FAIL;
    }

    unsigned seen = 0;
    esp_err_t err = ESP_OK;

    for (;;) {
        if (!sd_fs_lock(SD_LOCK_TIMEOUT_MS)) {
            err = ESP_FAIL;
            break;
        }
        const size_t got = fread(buf, 1, bufsz, f);
        sd_fs_unlock();

        if (got == 0) {
            break;                   /* end of file */
        }

        size_t send = got;
        for (size_t i = 0; i < got; i++) {
            if (buf[i] == '\n' && ++seen >= max_lines) {
                send = i + 1;        /* stop just past the last wanted line */
                break;
            }
        }

        err = httpd_resp_send_chunk(req, buf, send);
        if (err != ESP_OK || send != got) {
            break;
        }
    }

    if (err == ESP_OK) {
        err = httpd_resp_send_chunk(req, NULL, 0);   /* terminate */
    }
    return err;
}

/* ----------------------------------------------------------------- handlers */

static esp_err_t h_index(httpd_req_t *req)
{
    httpd_resp_set_type(req, "text/html; charset=utf-8");
    httpd_resp_set_hdr(req, "Cache-Control", "no-store");
    return httpd_resp_send(req, (const char *)index_html_start,
                           (ssize_t)(index_html_end - index_html_start));
}

static esp_err_t send_json_error(httpd_req_t *req, const char *msg)
{
    char body[128];
    snprintf(body, sizeof(body), "{\"error\":\"%s\",\"files\":[]}", msg);
    httpd_resp_set_type(req, "application/json");
    return httpd_resp_sendstr(req, body);
}

/* httpd_err_code_t has no 503, so the status line is set explicitly. */
static esp_err_t send_unavailable(httpd_req_t *req, const char *msg)
{
    httpd_resp_set_status(req, "503 Service Unavailable");
    httpd_resp_set_type(req, "text/plain; charset=utf-8");
    return httpd_resp_sendstr(req, msg);
}

static esp_err_t h_files(httpd_req_t *req)
{
    if (!logger_sd_mounted()) {
        return send_json_error(req, "TF card is not mounted");
    }

    httpd_resp_set_type(req, "application/json");
    httpd_resp_set_hdr(req, "Cache-Control", "no-store");

    if (!sd_fs_lock(SD_LOCK_TIMEOUT_MS)) {
        return send_json_error(req, "TF card busy");
    }

    DIR *dir = opendir(APP_LOG_MOUNT_POINT);
    if (!dir) {
        sd_fs_unlock();
        return send_json_error(req, "cannot list the TF card");
    }

    char out[224];
    int n = clamp_len(snprintf(out, sizeof(out),
                               "{\"mount\":\"%s\",\"logging\":%s,\"files\":[",
                               APP_LOG_MOUNT_POINT,
                               logger_is_logging() ? "true" : "false"),
                      sizeof(out));
    esp_err_t err = httpd_resp_send_chunk(req, out, n);

    bool first = true;
    struct dirent *e;
    while (err == ESP_OK && (e = readdir(dir)) != NULL) {
        if (e->d_name[0] == '.') {
            continue;
        }

        char path[96];
        if (!resolve_file(e->d_name, path, sizeof(path))) {
            continue;
        }

        struct stat st;
        if (stat(path, &st) != 0) {
            continue;
        }

        n = clamp_len(snprintf(out, sizeof(out), "%s{\"name\":\"%s\",\"size\":%lu}",
                               first ? "" : ",", e->d_name,
                               (unsigned long)st.st_size),
                      sizeof(out));
        if (n > 0) {
            err = httpd_resp_send_chunk(req, out, n);
        }
        first = false;
    }

    closedir(dir);
    sd_fs_unlock();

    if (err == ESP_OK) {
        err = httpd_resp_send_chunk(req, "]}", 2);
    }
    if (err == ESP_OK) {
        err = httpd_resp_send_chunk(req, NULL, 0);   /* terminate */
    }
    return err;
}

static esp_err_t h_download(httpd_req_t *req)
{
    char name[MAX_NAME_LEN + 1];
    if (!get_name_arg(req, name, sizeof(name)) || !name_is_safe(name)) {
        return httpd_resp_send_err(req, HTTPD_400_BAD_REQUEST, "missing or bad ?f=");
    }
    if (!logger_sd_mounted()) {
        return send_unavailable(req, "TF card is not mounted");
    }

    if (!sd_fs_lock(SD_LOCK_TIMEOUT_MS)) {
        return send_unavailable(req, "TF card busy");
    }

    char path[96];
    FILE *f = resolve_file(name, path, sizeof(path)) ? fopen(path, "r") : NULL;
    sd_fs_unlock();

    if (!f) {
        return httpd_resp_send_err(req, HTTPD_404_NOT_FOUND, "no such file");
    }

    char *buf = malloc(DOWNLOAD_CHUNK_BYTES);
    if (!buf) {
        sd_fs_lock(SD_LOCK_TIMEOUT_MS);
        fclose(f);
        sd_fs_unlock();
        return httpd_resp_send_err(req, HTTPD_500_INTERNAL_SERVER_ERROR, "out of memory");
    }

    httpd_resp_set_type(req, "application/octet-stream");
    char disp[128];
    snprintf(disp, sizeof(disp), "attachment; filename=\"%s\"", name);
    httpd_resp_set_hdr(req, "Content-Disposition", disp);

    esp_err_t err = ESP_OK;
    for (;;) {
        size_t got;

        if (!sd_fs_lock(SD_LOCK_TIMEOUT_MS)) {
            err = ESP_FAIL;
            break;
        }
        got = fread(buf, 1, DOWNLOAD_CHUNK_BYTES, f);
        sd_fs_unlock();

        if (got == 0) {
            break;
        }
        /* Unlocked on purpose: a slow client must not stall the logger. */
        err = httpd_resp_send_chunk(req, buf, got);
        if (err != ESP_OK) {
            break;
        }
    }

    free(buf);
    sd_fs_lock(SD_LOCK_TIMEOUT_MS);
    fclose(f);
    sd_fs_unlock();

    if (err == ESP_OK) {
        err = httpd_resp_send_chunk(req, NULL, 0);
    }
    return err;
}

static esp_err_t h_preview(httpd_req_t *req)
{
    char name[MAX_NAME_LEN + 1];
    if (!get_name_arg(req, name, sizeof(name)) || !name_is_safe(name)) {
        return httpd_resp_send_err(req, HTTPD_400_BAD_REQUEST, "missing or bad ?f=");
    }
    if (!logger_sd_mounted()) {
        return send_unavailable(req, "TF card is not mounted");
    }

    /* tail=1 returns the newest lines, which is what a live log needs. */
    bool tail = false;
    char query[160];
    char val[8];
    if (httpd_req_get_url_query_len(req) > 0 &&
        httpd_req_get_url_query_str(req, query, sizeof(query)) == ESP_OK &&
        httpd_query_key_value(query, "tail", val, sizeof(val)) == ESP_OK) {
        tail = (val[0] == '1');
    }

    const unsigned lines = APP_WEB_PREVIEW_LINES ? APP_WEB_PREVIEW_LINES : 1;

    if (!sd_fs_lock(SD_LOCK_TIMEOUT_MS)) {
        return send_unavailable(req, "TF card busy");
    }

    char path[96];
    FILE *f = resolve_file(name, path, sizeof(path)) ? fopen(path, "r") : NULL;
    if (!f) {
        sd_fs_unlock();
        return httpd_resp_send_err(req, HTTPD_404_NOT_FOUND, "no such file");
    }

    long fsize = 0;
    if (fseek(f, 0, SEEK_END) == 0) {
        fsize = ftell(f);
    }
    if (fsize < 0) {
        fsize = 0;
    }
    sd_fs_unlock();

    /*
     * One small fixed buffer, reused for the backward scan and for the forward
     * send. The size of the file no longer influences how much RAM the request
     * needs, which is the entire point. The previous version malloc'd up to
     * 64 KiB in a single call; with only ~200 KiB of total heap on an ESP32-C3
     * that failed for exactly the files worth previewing, and the user saw
     * "out of memory" instead of a log.
     */
    char *buf = malloc(PREVIEW_CHUNK_BYTES);
    if (!buf) {
        sd_fs_lock(SD_LOCK_TIMEOUT_MS);
        fclose(f);
        sd_fs_unlock();
        return send_unavailable(req, "out of memory");
    }

    long start = 0;
    if (tail) {
        start = tail_start_offset(f, fsize, lines, buf, PREVIEW_CHUNK_BYTES);
        if (start < 0) {
            free(buf);
            sd_fs_lock(SD_LOCK_TIMEOUT_MS);
            fclose(f);
            sd_fs_unlock();
            return send_unavailable(req, "TF card read failed");
        }
    }

    char hdr[56];
    snprintf(hdr, sizeof(hdr), "%s %u lines of %ld", tail ? "last" : "first",
             lines, fsize);

    httpd_resp_set_type(req, "text/plain; charset=utf-8");
    httpd_resp_set_hdr(req, "X-Preview", hdr);
    httpd_resp_set_hdr(req, "Cache-Control", "no-store");

    const esp_err_t err = stream_lines(req, f, start, lines, buf, PREVIEW_CHUNK_BYTES);

    free(buf);
    sd_fs_lock(SD_LOCK_TIMEOUT_MS);
    fclose(f);
    sd_fs_unlock();
    return err;
}

/* --------------------------------------------------------------------- API */

/*
 * Sanitise a float on its way into JSON.
 *
 * NaN and +/-inf are not representable in JSON and would make JSON.parse()
 * throw in the browser, which looks exactly like "the page is broken" rather
 * than like a sensor problem.
 *
 * The magnitude clamp is not cosmetic either: printf("%.4f") on a garbage float
 * (a flaky I2C read can return anything) expands to ~40 digits. With six such
 * numbers plus the lat/lon pair the object would overflow LIVE_JSON_BYTES and
 * be served truncated, i.e. as invalid JSON. Bounding the magnitude bounds the
 * worst-case length at ~450 bytes, which is why 512 is enough.
 */
static double json_num(double v)
{
    if (!isfinite(v)) {
        return 0.0;
    }
    if (v > 1e9) {
        return 1e9;
    }
    if (v < -1e9) {
        return -1e9;
    }
    return v;
}

/*
 * One JSON object with everything the live view needs. Shared by /imu (single
 * snapshot) and /stream (repeated push) so the two can never drift apart.
 */
static int build_live_json(char *out, size_t out_len)
{
    imu_sample_t  imu;
    mag_sample_t  mag;
    gnss_sample_t g;
    pps_stats_t   pps;

    app_state_get_sensors(&imu, &mag);
    app_state_get_gnss(&g, &pps);

    const int n = snprintf(
        out, out_len,
        "{\"t\":%lld,\"imu_ok\":%s,"
        "\"ax\":%.4f,\"ay\":%.4f,\"az\":%.4f,"
        "\"gx\":%.3f,\"gy\":%.3f,\"gz\":%.3f,"
        "\"mag_ok\":%s,\"mx\":%.2f,\"my\":%.2f,\"mz\":%.2f,"
        "\"fix\":%u,\"mode\":%u,\"sats\":%u,\"hdop\":%.2f,"
        "\"lat\":%.7f,\"lon\":%.7f,\"alt\":%.1f,"
        "\"utc_valid\":%s,\"utc\":\"%04u-%02u-%02uT%02u:%02u:%02u.%03uZ\","
        "\"pps\":%lu}",
        (long long)imu.t_us,
        imu.valid ? "true" : "false",
        json_num(imu.ax), json_num(imu.ay), json_num(imu.az),
        json_num(imu.gx), json_num(imu.gy), json_num(imu.gz),
        mag.valid ? "true" : "false",
        json_num(mag.mx), json_num(mag.my), json_num(mag.mz),
        (unsigned)g.fix_type, (unsigned)g.fix_mode, (unsigned)g.sats,
        json_num(g.hdop),
        json_num(g.pos_valid ? g.lat_deg : 0.0),
        json_num(g.pos_valid ? g.lon_deg : 0.0),
        json_num(g.pos_valid ? g.alt_msl_m : 0.0f),
        g.utc_valid ? "true" : "false",
        (unsigned)g.year, (unsigned)g.month, (unsigned)g.day,
        (unsigned)g.hour, (unsigned)g.minute, (unsigned)g.second,
        (unsigned)g.millisecond,
        (unsigned long)pps.seq);

    return clamp_len(n, out_len);
}

static esp_err_t h_imu(httpd_req_t *req)
{
    char body[LIVE_JSON_BYTES];
    const int n = build_live_json(body, sizeof(body));

    httpd_resp_set_type(req, "application/json");
    httpd_resp_set_hdr(req, "Cache-Control", "no-store");
    return httpd_resp_send(req, body, n);
}

/*
 * The I2C scan report, on demand.
 *
 * This is what makes physical debugging practical: unplug a module, plug it
 * somewhere else, reload the page and scan again - no serial console, no
 * reflash. It runs concurrently with the sensor tasks, which is safe because
 * the i2c_master driver serialises transactions on the bus.
 */
static esp_err_t h_i2c(httpd_req_t *req)
{
    char report[1400];
    i2c_diag_report(report, sizeof(report));

    httpd_resp_set_type(req, "text/plain; charset=utf-8");
    httpd_resp_set_hdr(req, "Cache-Control", "no-store");
    return httpd_resp_sendstr(req, report);
}

/*
 * Server-sent events: the browser opens one EventSource and the device pushes a
 * fresh snapshot every APP_WEB_STREAM_PERIOD_MS. SSE needs no handshake or
 * framing code (unlike a WebSocket) and reconnects by itself after a page
 * reload or a dropped connection.
 *
 * The loop exits as soon as a write fails, which is how a client that navigated
 * away releases its socket.
 */
static esp_err_t h_stream(httpd_req_t *req)
{
    char json[LIVE_JSON_BYTES];
    char body[LIVE_JSON_BYTES + 16];

    httpd_resp_set_type(req, "text/event-stream");
    httpd_resp_set_hdr(req, "Cache-Control", "no-store");
    httpd_resp_set_hdr(req, "X-Accel-Buffering", "no");

    const TickType_t period = pdMS_TO_TICKS(APP_WEB_STREAM_PERIOD_MS);

    /* One priming comment so the browser fires onopen immediately instead of
     * waiting for the first sample. */
    if (httpd_resp_send_chunk(req, ": live\n\n", 8) != ESP_OK) {
        return ESP_OK;
    }

    for (;;) {
        build_live_json(json, sizeof(json));
        const int n = clamp_len(snprintf(body, sizeof(body), "data: %s\n\n", json),
                                sizeof(body));

        if (httpd_resp_send_chunk(req, body, n) != ESP_OK) {
            break;                  /* client went away */
        }
        vTaskDelay(period);
    }
    return ESP_OK;
}

esp_err_t web_server_start(void)
{
    httpd_config_t cfg = HTTPD_DEFAULT_CONFIG();
    cfg.server_port = APP_WEB_PORT;
    cfg.stack_size = 8192;      /* handlers build strings on the stack */
    cfg.max_uri_handlers = 8;
    cfg.lru_purge_enable = true;

    static const httpd_uri_t routes[] = {
        { .uri = "/",         .method = HTTP_GET, .handler = h_index,    .user_ctx = NULL },
        { .uri = "/files",    .method = HTTP_GET, .handler = h_files,    .user_ctx = NULL },
        { .uri = "/download", .method = HTTP_GET, .handler = h_download, .user_ctx = NULL },
        { .uri = "/preview",  .method = HTTP_GET, .handler = h_preview,  .user_ctx = NULL },
        { .uri = "/imu",      .method = HTTP_GET, .handler = h_imu,      .user_ctx = NULL },
        { .uri = "/stream",   .method = HTTP_GET, .handler = h_stream,   .user_ctx = NULL },
        { .uri = "/i2c",      .method = HTTP_GET, .handler = h_i2c,      .user_ctx = NULL },
    };

    httpd_handle_t server = NULL;
    const esp_err_t err = httpd_start(&server, &cfg);
    if (err != ESP_OK) {
        ESP_LOGE(TAG, "httpd_start failed: %s", esp_err_to_name(err));
        return err;
    }

    for (size_t i = 0; i < sizeof(routes) / sizeof(routes[0]); i++) {
        if (httpd_register_uri_handler(server, &routes[i]) != ESP_OK) {
            ESP_LOGE(TAG, "failed to register %s", routes[i].uri);
        }
    }

    ESP_LOGI(TAG, "web UI on port %d (/ , /files , /download , /preview , /imu , /stream , /i2c)",
             (int)APP_WEB_PORT);
    return ESP_OK;
}
